## lib/utils/arm_scmi/Kconfig
```kconfig
# SPDX-License-Identifier: BSD-2-Clause

config ARM_SCMI_PROTOCOL_SUPPORT
	bool "Support scmi protocol"
	select ARM_PSCI_SUPPORT
	default n
```

## lib/utils/psci/Kconfig
```kconfig
# SPDX-License-Identifier: BSD-2-Clause

config ARM_PSCI_SUPPORT
	bool "Support psci protocol"
	default n
```

## platform/generic/configs/k1-pro_fpga_defconfig
```kconfig
CONFIG_PLATFORM_SPACEMIT_K1PRO=y
CONFIG_PLATFORM_SPACEMIT_K1PRO_FPGA=y
CONFIG_FDT_IPI=y
CONFIG_FDT_IPI_MSWI=y
CONFIG_FDT_IPI_PLICSW=y
CONFIG_FDT_IRQCHIP=y
CONFIG_FDT_IRQCHIP_PLIC=y
CONFIG_FDT_RESET=y
CONFIG_FDT_RESET_HTIF=y
CONFIG_FDT_RESET_SIFIVE_TEST=y
CONFIG_FDT_RESET_SUNXI_WDT=y
CONFIG_FDT_RESET_THEAD=y
CONFIG_FDT_SERIAL=y
CONFIG_FDT_SERIAL_UART8250=y
CONFIG_FDT_TIMER=y
CONFIG_FDT_TIMER_MTIMER=y
```

## platform/generic/configs/k3_defconfig
```kconfig
CONFIG_PLATFORM_SPACEMIT_K3=y
CONFIG_FDT_HSM=y
CONFIG_FDT_HSM_RPMI=y
CONFIG_FDT_IPI=y
CONFIG_FDT_IPI_MSWI=y
CONFIG_FDT_IPI_PLICSW=y
CONFIG_FDT_IRQCHIP=y
CONFIG_FDT_IRQCHIP_APLIC=y
CONFIG_FDT_IRQCHIP_IMSIC=y
CONFIG_FDT_IRQCHIP_PLIC=y
CONFIG_FDT_MAILBOX=y
CONFIG_RPMI_MAILBOX=y
CONFIG_FDT_MAILBOX_RPMI_SHMEM=y
CONFIG_FDT_RESET=y
CONFIG_FDT_RESET_HTIF=y
CONFIG_FDT_RESET_RPMI=y
CONFIG_FDT_RESET_SUNXI_WDT=y
CONFIG_FDT_SERIAL=y
CONFIG_FDT_SERIAL_UART8250=y
CONFIG_FDT_SUSPEND=y
CONFIG_FDT_SUSPEND_RPMI=y
CONFIG_FDT_TIMER=y
CONFIG_FDT_TIMER_MTIMER=y
CONFIG_FDT_MPXY=y
CONFIG_FDT_MPXY_RPMI_MBOX=y
CONFIG_FDT_MPXY_RPMI_CLOCK=y
CONFIG_FDT_MPXY_RPMI_VOLTAGE=y
CONFIG_FDT_MPXY_RPMI_DOMAIN=y
CONFIG_FDT_MPXY_RPMI_RTC=y
CONFIG_FDT_MPXY_RPMI_PWRKEY=y
CONFIG_FDT_MPXY_OPTEED=y
CONFIG_CCI=y
CONFIG_CCI_550=y
```
